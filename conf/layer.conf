## conf/layer.conf
```bitbake
# We have a conf and classes directory, add to BBPATH
BBPATH .= ":${LAYERDIR}"

# We have a packages directory, add to BBFILES
BBFILES += "${LAYERDIR}/recipes-*/*/*.bb \
            ${LAYERDIR}/recipes-*/*/*.bbappend"

BBFILE_COLLECTIONS        += "ai"
BBFILE_PATTERN_ai := "^${LAYERDIR}/"
BBFILE_PRIORITY_ai = "10"

LAYERDEPENDS_ai = " \
    core \
    openembedded-layer \
"
LAYERSERIES_COMPAT_ai = "wrynose"
```
